## conf/distro/include/sane-assume-toolchain.inc
```bitbake
# Originally brought to you by the Angstrom Distribution

# Branding
TARGET_VENDOR = ""

#mess with compiler flags to use -Os instead of -O2
#Please see http://free-electrons.com/doc/embedded_linux_optimizations/img47.html for some more info
# perl has some problems, see http://bugs.openembedded.net/show_bug.cgi?id=1616
# [23:00] oxo: glibc (any version) on sparc does not like (repeat me) "-Os"

FULL_OPTIMIZATION = "-fexpensive-optimizations -frename-registers -fomit-frame-pointer -O2"

FULL_OPTIMIZATION_pn-perl = "-fexpensive-optimizations -fomit-frame-pointer -frename-registers -O1"
FULL_OPTIMIZATION_pn-glibc = "-fexpensive-optimizations -fomit-frame-pointer -O2"
FULL_OPTIMIZATION_sparc = "-fexpensive-optimizations -fomit-frame-pointer -frename-registers -O2"

BUILD_OPTIMIZATION_pn-perl = "-O1"
BUILD_OPTIMIZATION_pn-glibc = "-O2"
BUILD_OPTIMIZATION_sparc = "-O2"

TARGET_LINK_HASH_STYLE = ""

CXXFLAGS += "-fvisibility-inlines-hidden"

#########################################################################
def detect_arm_abi (d):
	import bb
	if bb.data.getVar('DISTRO_FEATURES',d) is None:
		if bb.data.getVar('TARGET_ARCH', d, 1) in [ 'arm', 'armeb' ]:
			return "oabi"
		else:
			return ""
	if bb.data.getVar('TARGET_ARCH', d, 1) in [ 'arm', 'armeb' ]:
		if 'eabi' in bb.data.getVar('DISTRO_FEATURES',d).split():
			return "eabi"
		return "oabi"
	return ""

def compute_os_portion_of_target_triplet (d):
	import bb
	arm_eabi_unsupported_arches = "armv1 armv2 armv3"
	ppc_spe_supporting_arches = "ppce500v2 ppce500"
	gnu_suffix = ""
	if bb.data.getVar('LIBC', d, 1) == "uclibc":
		libc_suffix = "uclibc"
	else:
		libc_suffix = ""
	
	if bb.data.getVar('TARGET_ARCH',d,1) in ['bfin']:
		if libc_suffix is not "uclibc":
			bb.fatal("bfin is not supported on glibc/eglibc. Please choose uclibc")
		else:
			os_suffix = "uclinux"
	else:
		os_suffix = "linux"
	bparch = bb.data.getVar('BASE_PACKAGE_ARCH', d,1)

	if bb.data.getVar('DISTRO_FEATURES',d,1) is not None and \
	bparch is not None:
		if 'eabi' in bb.data.getVar('DISTRO_FEATURES',d,1).split() and \
		bb.data.getVar('TARGET_ARCH', d, 1) in [ 'arm', 'armeb' ]:
			if bparch in arm_eabi_unsupported_arches.split():
				bb.fatal("DISTRO requested EABI but selected machine does not support EABI")
				abi_suffix = ""
			else:
				if libc_suffix is not "uclibc":
					gnu_suffix = "gnu"
				abi_suffix = "eabi"
		elif bparch in ppc_spe_supporting_arches.split():
			if libc_suffix is not "uclibc":
				gnu_suffix = "gnu"
			abi_suffix = "spe"
		else:
			abi_suffix = ""
	else:
		bb.note("DISTRO_FEATURES is not set abi suffix not set")
		abi_suffix = ""
	if libc_suffix is not "" or abi_suffix is not "":
		return os_suffix + "-" + libc_suffix + gnu_suffix + abi_suffix
	else:
		return os_suffix

# This is needed to get a correct PACKAGE_ARCH for packages that have PACKAGE_ARCH = ${MACHINE_ARCH}
ARM_ABI = "${@detect_arm_abi(d)}"
TARGET_OS = "${@compute_os_portion_of_target_triplet(d)}"
```

## conf/distro/include/toolchain-external.inc
```bitbake
# Toolchain specific virtuals
PREFERRED_PROVIDER_virtual/${TARGET_PREFIX}binutils = "external-toolchain-${TOOLCHAIN_BRAND}"
PREFERRED_PROVIDER_virtual/${TARGET_PREFIX}gcc-initial = "external-toolchain-${TOOLCHAIN_BRAND}"
PREFERRED_PROVIDER_virtual/${TARGET_PREFIX}gcc-intermediate = "external-toolchain-${TOOLCHAIN_BRAND}"
PREFERRED_PROVIDER_virtual/${TARGET_PREFIX}gcc = "external-toolchain-${TOOLCHAIN_BRAND}"
PREFERRED_PROVIDER_virtual/${TARGET_PREFIX}g++ = "external-toolchain-${TOOLCHAIN_BRAND}"
PREFERRED_PROVIDER_virtual/libc = "external-toolchain-${TOOLCHAIN_BRAND}"
PREFERRED_PROVIDER_virtual/${TARGET_PREFIX}libc-for-gcc = "external-toolchain-${TOOLCHAIN_BRAND}"
PREFERRED_PROVIDER_virtual/${TARGET_PREFIX}libc-initial = "external-toolchain-${TOOLCHAIN_BRAND}"
PREFERRED_PROVIDER_virtual/libiconv = "external-toolchain-${TOOLCHAIN_BRAND}"
PREFERRED_PROVIDER_virtual/libintl = "external-toolchain-${TOOLCHAIN_BRAND}"
PREFERRED_PROVIDER_linux-libc-headers ?= "external-toolchain-${TOOLCHAIN_BRAND}"
PREFERRED_PROVIDER_gdbserver ?= "external-toolchain-${TOOLCHAIN_BRAND}"

TOOLCHAIN_VENDOR ?= "${TARGET_VENDOR}"
TARGET_VENDOR := "${TOOLCHAIN_VENDOR}"
```

## conf/machine/dm800.conf
```bitbake
#@TYPE: Machine
#@NAME: Dreambox DM 800 HD PVR
#@DESCRIPTION: Machine configuration for the Dreambox DM 800 HD PVR

PREFERRED_VERSION_wpa-supplicant = "0.5.8"

#take care when you do changes on MACHINE_ESSENTIAL_EXTRA_RDEPENDS/RRECOMMENDS you have to increment the recipes/tasks/task-boot.bb PR

#MACHINE_ESSENTIAL_EXTRA_RDEPENDS = "\
#	kernel-module-nls-iso8859-1 \
#	kernel-module-nls-iso8859-15 \
#	kernel-module-nls-cp437 \
#	kernel-module-nls-cp850 \
#	kernel-module-nls-utf8 \
#"
#	v4l-dvb-module-dvb-core \
#	v4l-dvb-module-stv0299 \

MACHINE_ESSENTIAL_EXTRA_RDEPENDS = " "

module_autoload_nls-iso8859-1 = "nls-iso8859-1"
module_autoload_nls-iso8859-15 = "nls-iso8859-15"
module_autoload_nls-cp437 = "nls-cp437"
module_autoload_nls-cp850 = "nls-cp850"
module_autoload_nls-utf8 = "nls-utf8"
#module_autoload_dvb-core = "dvb-core"
#module_autoload_stv0299 = "stv0299"

MACHINE_ESSENTIAL_EXTRA_RRECOMMENDS = "\
	kernel-module-cifs \
	kernel-module-exportfs \
	kernel-module-ext2 \
	kernel-module-xfs \
	kernel-module-iso9660 \
	kernel-module-udf \
	kernel-module-cdfs \
"

module_autoload_cifs = "cifs"
module_autoload_exportfs = "exportfs"
module_autoload_ext2 = "ext2"
module_autoload_xfs = "xfs"
module_autoload_iso9660 = "iso9660"
module_autoload_udf = "udf"
module_autoload_cdfs = "cdfs"
module_autoload_ntfs = "ntfs"

MACHINE_EXTRA_RRECOMMENDS = " \
	dreambox-boot-progress \
	su980-shutdown \
	iperf \
	"

# gst-plugin-dvbmediasink \
# rt73 \

KERNEL_EXTRA_CMD = "--disable-compressor=lzo "

EXTRA_IMAGECMD_jffs2 = " --eraseblock=0x20000 -n -l "
IMAGE_CMD_jffs2 = "\
	mkfs.jffs2 \
		--root=${IMAGE_ROOTFS} \
		--faketime \
		${KERNEL_EXTRA_CMD} \
		--compression-mode=size \
		--output=${DEPLOY_DIR_IMAGE}/${IMAGE_NAME}.rootfs.jffs2 \
		${EXTRA_IMAGECMD}"

#	buildimage ${STAGING_LIBDIR}/dreambox-secondstage/main.bin.gz \
#		${DEPLOY_DIR_IMAGE}/${IMAGE_NAME}.boot.jffs2 \
#		${DEPLOY_DIR_IMAGE}/${IMAGE_NAME}.rootfs.jffs2 \
#		${MACHINE} 64 \
#		> ${DEPLOY_DIR_IMAGE}/${IMAGE_NAME}.nfi"

MACHINE_FEATURES += "usbhost modem wifi"

# openpli specific features:
#MACHINE_FEATURES += "32bpp hdtv dvb-c blindscan dvbapi5"
MACHINE_FEATURES += "32bpp hdtv blindscan"

require conf/machine/include/dreambox-arm.inc
include conf/machine/include/autoload-usbserial.inc

SYSVINIT_ENABLED_GETTYS = ""
SERIAL_CONSOLE_arm = "115200 ttyS1"
```

## conf/machine/include/dreambox-arm.inc
```bitbake
# dreambox-mipsel.inc

MACHINE_FEATURES += "alsa"
MACHINE_KERNEL_PR = "r6"

#PREFERRED_VERSION_linux = "2.6.34"
PREFERRED_VERSION_linux-libc-headers = "2.6.34"

PREFERRED_VERSION_madwifi-ng = "r3314-20080131"

PREFERRED_PROVIDER_virtual/showiframe = "su980-dvb-tools"
PREFERRED_PROVIDER_virtual/blindscanutils = "dreambox-blindscan-utils"

TARGET_ARCH = "arm"
TARGET_FPU ?= "soft"

#Archer:We use external toolchain to provide linux-libc-headers
#PREFERRED_PROVIDER_linux-libc-headers 	= "linux-libc-headers"

require conf/machine/include/dreambox.inc
require conf/machine/include/tune-cortexa9.inc
```
